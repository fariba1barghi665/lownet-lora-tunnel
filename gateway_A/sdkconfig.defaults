## gateway_A/sdkconfig.defaults
```kconfig
CONFIG_DEVICE_TYPE_GATEWAY=y
CONFIG_DEVICE_TYPE_NODE=n
CONFIG_ESP_WIFI_STA_DISCONNECTED_PM_ENABLE=n
CONFIG_ESP_NOW_MAX_TOTAL_PEER_NUM=20
CONFIG_FREERTOS_HZ=1000
CONFIG_LOG_DEFAULT_LEVEL_INFO=y
CONFIG_ESP32_DEFAULT_CPU_FREQ_240=y
```
